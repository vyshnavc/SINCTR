## poky/meta-custom-network/conf/layer.conf
```bitbake
# We have a conf and classes directory, add to BBPATH
BBPATH .= ":${LAYERDIR}"

# We have recipes-* directories, add to BBFILES
BBFILES += "${LAYERDIR}/recipes-*/*/*.bb \
            ${LAYERDIR}/recipes-*/*/*.bbappend"

BBFILE_COLLECTIONS += "meta-custom-network"
BBFILE_PATTERN_meta-custom-network = "^${LAYERDIR}/"
BBFILE_PRIORITY_meta-custom-network = "6"

LAYERDEPENDS_meta-custom-network = "core"
LAYERSERIES_COMPAT_meta-custom-network = "styhead walnascar"
```
